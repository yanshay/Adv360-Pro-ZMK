## config/west.yml
```yaml
manifest:
  remotes:
    - name: zmkfirmware
      url-base: https://github.com/zmkfirmware
    - name: urob
      url-base: https://github.com/urob
    - name: yanshay
      url-base: https://github.com/yanshay
  projects:
    - name: urob-zmk
      remote: yanshay
      path: zmk
      revision: adv360-led
      import: app/west.yml
  self:
    path: config
```
